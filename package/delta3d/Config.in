## package/delta3d/uvexposure/Config.in
```kconfig
config BR2_PACKAGE_UVEXPOSURE
	bool "uvexposure"
    select BR2_PACKAGE_QT6BASE
    select BR2_PACKAGE_QT6BASE_NETWORK
    select BR2_PACKAGE_QT6WEBSOCKETS
    select BR2_PACKAGE_QT6WAYLAND
    select BR2_PACKAGE_QT6SVG
    select BR2_PACKAGE_QT6VIRTUALKEYBOARD
    select BR2_PACKAGE_QT6DECLARATIVE
    select BR2_PACKAGE_QT6DECLARATIVE_QUICK
    select BR2_PACKAGE_QT6QT5COMPAT
    select BR2_PACKAGE_CAIRO
    select BR2_PACKAGE_PANGO
    select BR2_PACKAGE_LIBGLIB2
	help
	  Install uvexposure application.
```

## package/double-conversion/Config.in
```kconfig
config BR2_PACKAGE_DOUBLE_CONVERSION
	bool "double-conversion"
  depends on !BR2_nds32
	depends on BR2_INSTALL_LIBSTDCPP

	help
	  Provides binary-decimal and decimal-binary routines for
	  IEEE doubles.

	  https://github.com/google/double-conversion

comment "double-conversion needs a toolchian w/ C++
	depends on !BR2_INSTALL_LIBSTDCPP
```

## package/qt6/Config.in
```kconfig
#config BR2_PACKAGE_QT6_GL_AVAILABLE
#	bool
#	default y
#	depends on BR2_PACKAGE_HAS_LIBGL || BR2_PACKAGE_HAS_LIBGLES

#config BR2_PACKAGE_QT6_JSCORE_AVAILABLE
#	bool
#	default y
#	# Javascript engine is only available on certain architectures
#	depends on BR2_arm || BR2_aarch64 || BR2_i386 || BR2_x86_64 || BR2_mipsel
#	# ARM needs BLX, so v5t+
#	depends on !BR2_ARM_CPU_ARMV4

comment "Qt6 needs host g++ >= 9.0, and a toolchain w/ gcc >= 9.0, wchar, NPTL, C++, dynamic library"
	depends on !BR2_ARM_CPU_ARMV4
	depends on !BR2_arc
	depends on !BR2_INSTALL_LIBSTDCPP || !BR2_USE_WCHAR || \
		!BR2_TOOLCHAIN_HAS_THREADS_NPTL || BR2_STATIC_LIBS || \
		!BR2_HOST_GCC_AT_LEAST_9 || !BR2_TOOLCHAIN_GCC_AT_LEAST_9

menuconfig BR2_PACKAGE_QT6
	bool "Qt6"
	depends on BR2_INSTALL_LIBSTDCPP
	depends on BR2_USE_WCHAR
	depends on BR2_TOOLCHAIN_HAS_THREADS_NPTL
	depends on BR2_HOST_GCC_AT_LEAST_9 # Full C++11
	depends on BR2_TOOLCHAIN_GCC_AT_LEAST_9 # C++11, GCC_BUG_57694
	depends on !BR2_ARM_CPU_ARMV4 # needs ARMv5+
	# no built-in double-conversion support
	depends on !BR2_arc
	depends on !BR2_STATIC_LIBS
	select BR2_PACKAGE_QT6BASE
	help
	  This option enables the Qt6 framework. Sub-options allow to
	  select which modules should be built.

	  http://qt.io

if BR2_PACKAGE_QT6
source "package/qt6/qt6-base/Config.in"
source "package/qt6/qt6-websockets/Config.in"
source "package/qt6/qt6-virtualkeyboard/Config.in"
#source "package/qt6/qt63d/Config.in"
#source "package/qt6/qt6charts/Config.in"
#source "package/qt6/qt6coap/Config.in"
#source "package/qt6/qt6connectivity/Config.in"
#source "package/qt6/qt6declarative/Config.in"
#source "package/qt6/qt6enginio/Config.in"
#source "package/qt6/qt6graphicaleffects/Config.in"
#source "package/qt6/qt6imageformats/Config.in"
#source "package/qt6/qt6knx/Config.in"
#source "package/qt6/qt6location/Config.in"
#source "package/qt6/qt6lottie/Config.in"
#source "package/qt6/qt6mqtt/Config.in"
#source "package/qt6/qt6multimedia/Config.in"
#source "package/qt6/qt6quickcontrols/Config.in"
#source "package/qt6/qt6quickcontrols2/Config.in"
#source "package/qt6/qt6quicktimeline/Config.in"
#source "package/qt6/qt6remoteobjects/Config.in"
#source "package/qt6/qt6script/Config.in"
#source "package/qt6/qt6scxml/Config.in"
#source "package/qt6/qt6sensors/Config.in"
#source "package/qt6/qt6serialbus/Config.in"
#source "package/qt6/qt6serialport/Config.in"
#source "package/qt6/qt6svg/Config.in"
#source "package/qt6/qt6tools/Config.in"
#source "package/qt6/qt6wayland/Config.in"
#source "package/qt6/qt6webchannel/Config.in"
#source "package/qt6/qt6webkit/Config.in"
#source "package/qt6/qt6webkit-examples/Config.in"
#source "package/qt6/qt6webengine/Config.in"
#source "package/qt6/qt6webview/Config.in"
#source "package/qt6/qt6x11extras/Config.in"
#source "package/qt6/qt6xmlpatterns/Config.in"
endif
```

## package/qt6/qt6-virtualkeyboard/Config.in
```kconfig
config BR2_PACKAGE_QT6VIRTUALKEYBOARD
	bool "qt6-virtualkeyboard"
	select BR2_PACKAGE_QT6BASE
	help
	  Qt is a cross-platform application and UI framework for
	  developers using C++.

		Qt Virtual Keyboard is a virtual keyboard framework that
	  consists of a C++ backend supporting custom input methods as
	  well as a UI frontend implemented in QML.

	  http://doc.qt.io/qt-6/qtvirtualkeyboard-index.html

if BR2_PACKAGE_QT6VIRTUALKEYBOARD

config BR2_PACKAGE_QT6VIRTUALKEYBOARD_LANGUAGE_LAYOUTS
	string "language layouts"
	default "en_GB"
	help
	  The Virtual Keyboard supports the following languages:
	  - Arabic (ar_AR)
	  - Danish (da_DK)
	  - English (en_GB)
	  - Finnish (fi_FI)
	  - French (fr_FR)
	  - German (de_DE)
	  - Hindi (hi_IN)
	  - Italian (it_IT)
	  - Japanese (ja_JP)
	  - Korean (ko_KR)
	  - Norwegian (nb_NO)
	  - Persian/Farsi (fa_FA)
	  - Polish (pl_PL)
	  - Portugese (pt_PT)
		- Portugese Brazil (pt_BR)
	  - Romanian (ro_RO)
	  - Russian (ru_RU)
	  - Simplified Chinese (zh_CN)
	  - Traditional Chinese (zh_TW)
	  - Spanish (es_ES)
	  - Swedish (sv_SE)

	  Note: the special value "all" can be used to install support
	  for all supported languages.

config BR2_PACKAGE_QT6VIRTUALKEYBOARD_HANDWRITING
	bool "handwriting"
	help
	  Handwriting support, with gestures for fullscreen input.

	  Lipi Toolkit (LipiTk) is an open source toolkit for online
	  Handwriting Recognition.

config BR2_PACKAGE_QT6VIRTUALKEYBOARD_ARROW_KEY_NAVIGATION
	bool "Arrow key navigation"
	help
	  Allows controlling the keyboard using the arrow and return
	  keys.

endif
```

## package/qt6/qt6-websockets/Config.in
```kconfig
config BR2_PACKAGE_QT6WEBSOCKETS
	bool "qt6-websockets"
	select BR2_PACKAGE_QT6BASE
	select BR2_PACKAGE_QT6BASE_NETWORK
	help
	  Qt is a cross-platform application and UI framework for
	  developers using C++.

	  The Qt WebSockets module provides C++ and QML interfaces
	  that enable Qt applications to act as a server that can
	  process WebSocket requests, or a client that can
	  consume data received from the server, or both.

	  http://doc.qt.io/qt-6/qtwebsockets-index.html
```

## package/qt6/qt6declarative/Config.in
```kconfig
config BR2_PACKAGE_QT6DECLARATIVE
	bool "qt6-declarative"
	select BR2_PACKAGE_QT6BASE
	help
		Qt is a cross-platform application and UI framework for
		developers using C++.

		Qt Declarative module provides the Qt QML and Qt Quick
		modules for developing UIs with the QML language

		https://doc.qt.io/qt-6/qtqml-index.html

	if BR2_PACKAGE_QT6DECLARATIVE

	config BR2_PACKAGE_QT6DECLARATIVE_QUICK
		bool "quick module"
		depends on BR2_PACKAGE_QT6BASE_OPENGL
		depends on BR2_PACKAGE_QT6BASE_TEST
		depends on BR2_PACKAGE_QT6SHADERTOOLS
		help
			Quick/QuickControls support

	comment "Quick depends on Qt6 OpenGL module"
		depends on !BR2_PACKAGE_QT6BASE_OPENGL

	comment "Quick depends on Qt6 Test module"
		depends on !BR2_PACKAGE_QT6BASE_TEST

	endif
```

## package/qt6/qt6qt5compat/Config.in
```kconfig
config BR2_PACKAGE_QT6QT5COMPAT
	bool "qt6-qt5-compatibility"
	select BR2_PACKAGE_QT6BASE
	help
	  Qt is a cross-platform application and UI framework for
	  developers using C++.

	  This is a compatibility layer to some qt5 features.

		https://doc.qt.io/qt-6/qtgraphicaleffects5-index.html
```

## package/qt6/qt6shadertools/Config.in
```kconfig
config BR2_PACKAGE_QT6SHADERTOOLS
	bool "qt6-shadertools"
	select BR2_PACKAGE_QT6BASE
	help
		Qt is a cross-platform application and UI framework for
		developers using C++.

		Qt Declarative module provides the Qt QML and Qt Quick
		modules for developing UIs with the QML language

		https://doc.qt.io/qt-6/qtqml-index.html
```

## package/qt6/qt6svg/Config.in
```kconfig
config BR2_PACKAGE_QT6SVG
	bool "qt6-svg"
	select BR2_PACKAGE_QT6BASE
	help
		Qt is a cross-platform application and UI framework for
		developers using C++.

		Qt SVG provides classes for rendering and displaying SVG
		drawings in widgets and on other paint devices.

		http://doc.qt.io/qt-6/qtsvg-index.html
```

## package/qt6/qt6tools/Config.in
```kconfig
config BR2_PACKAGE_QT6TOOLS
	bool "qt6-tools"
	select BR2_PACKAGE_QT6BASE
	select BR2_PACKAGE_QT6BASE_NETWORK
	help
		Qt is a cross-platform application and UI framework for
		developers using C++.

		Qt Tools provides tools facilitate the development
		and design of applications.

		http://doc.qt.io/qt-6/qtmodules.html#qt-tools

if BR2_PACKAGE_QT6TOOLS

#config BR2_PACKAGE_QT6TOOLS_LINGUIST_TOOLS
#	bool "Linguist host tools (lconvert, lrelease, lupdate)"
#	help
#	  This option enables the linguist host tools
#	  lconvert, lrelease and lupdate.

#config BR2_PACKAGE_QT6TOOLS_QDOC_TOOL
#	bool "qdoc host tool"
	# Needs llvm-config and libclang for the host, which is not
	# currently supported in Buildroot, unless the target is
	# already supported by llvm.
#	depends on BR2_PACKAGE_LLVM_ARCH_SUPPORTS # llvm, clang
#	depends on BR2_TOOLCHAIN_GCC_AT_LEAST_9_0 # llvm, clang
#	depends on BR2_TOOLCHAIN_HAS_THREADS # llvm, clang
#	depends on BR2_INSTALL_LIBSTDCPP # llvm, clang
#	depends on !BR2_TOOLCHAIN_HAS_GCC_BUG_64735 # llvm, clang
#	depends on !BR2_STATIC_LIBS # llvm, clang
#	depends on BR2_USE_WCHAR # llvm, clang
#	help
#	  This option enables the qdoc host tool.

#config BR2_PACKAGE_QT6TOOLS_PIXELTOOL
#	bool "pixeltool"
#	select BR2_PACKAGE_QT6BASE_GUI
#	select BR2_PACKAGE_QT6BASE_WIDGETS
#	select BR2_PACKAGE_QT6BASE_PNG # saving png images
#	help
#	  Compile and install the pixeltool program.

#config BR2_PACKAGE_QT6TOOLS_QTDIAG
#	bool "qtdiag"
#	select BR2_PACKAGE_QT6BASE_GUI
#	help
#	  Compile and install the qtdiag program.

#config BR2_PACKAGE_QT6TOOLS_QTPATHS
#	bool "qtpaths"
#	help
#	  Compile and install the qtpaths program.

#config BR2_PACKAGE_QT6TOOLS_QTPLUGININFO
#	bool "qtplugininfo"
#	help
#	  Compile and install the qtplugininfo program.

endif
```

## package/qt6/qt6translation/Config.in
```kconfig
comment "QT6 Translation module depends on QT6 Declarative module"
  depends on !BR2_PACKAGE_QT6DECLARATIVE
	
config BR2_PACKAGE_QT6TRANSLATION
	bool "qt6-translation"
	depends on BR2_PACKAGE_QT6DECLARATIVE
	select BR2_PACKAGE_QT6BASE
	select BR2_PACKAGE_QT6TOOLS
	help
	  Qt is a cross-platform application and UI framework for
	  developers using C++.

	  The Qt Translation contains the QT translation catalog

	  https://doc.qt.io/qt-6/internationalization.html
```

## package/qt6/qt6virtualkeyboard/Config.in
```kconfig
config BR2_PACKAGE_QT6VIRTUALKEYBOARD
	bool "qt6-virtualkeyboard"
	select BR2_PACKAGE_QT6BASE
	select BR2_PACKAGE_QT6DECLARATIVE
	select BR2_PACKAGE_QT6SVG
	help
	  Qt is a cross-platform application and UI framework for
	  developers using C++.

		Qt Virtual Keyboard is a virtual keyboard framework that
	  consists of a C++ backend supporting custom input methods as
	  well as a UI frontend implemented in QML.

	  http://doc.qt.io/qt-6/qtvirtualkeyboard-index.html

if BR2_PACKAGE_QT6VIRTUALKEYBOARD

config BR2_PACKAGE_QT6VIRTUALKEYBOARD_ARROW_KEY_NAVIGATION
	bool "Arrow key navigation"
	help
	  Allows controlling the keyboard using the arrow and return
	  keys.

endif
```

## package/qt6/qt6wayland/Config.in
```kconfig
comment "QT Wayland depends on Wayland"
	depends on !BR2_PACKAGE_WAYLAND

comment "qt5wayland needs an OpenGL-capable backend"
	depends on !BR2_PACKAGE_QT6_GL_AVAILABLE
	
config BR2_PACKAGE_QT6WAYLAND
	bool "qt6-wayland"
	depends on BR2_PACKAGE_WAYLAND
	select BR2_PACKAGE_QT6BASE
	help
	  Qt is a cross-platform application and UI framework for
	  developers using C++.

	  The Qt WebSockets module provides C++ and QML interfaces
	  that enable Qt applications to act as a server that can
	  process WebSocket requests, or a client that can
	  consume data received from the server, or both.

	  http://doc.qt.io/qt-6/qtwayland-index.html
```
